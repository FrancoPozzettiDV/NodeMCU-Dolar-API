/*
Librerias:

https://github.com/bblanchon/ArduinoJson
https://github.com/adafruit/Adafruit-GFX-Library
https://github.com/adafruit/Adafruit_SSD1306
*/


#include <Arduino.h>

#include <ESP8266WiFi.h>
#include <ESP8266WiFiMulti.h>
#include <ArduinoJson.h>
#include <ESP8266HTTPClient.h>
#include <SPI.h>
#include <Wire.h>
#include <Adafruit_GFX.h>
#include <Adafruit_SSD1306.h> 

#include <WiFiClientSecureBearSSL.h>
// Fingerprint o huella digital del sitio a consultar. Si se quiere hacer una peticion a otro sitio, modificar estos valores.
const uint8_t fingerprint[20] = {0xe4, 0x7a, 0x77, 0x7a, 0xd4, 0x6e, 0x0e, 0xd8, 0x70, 0x19, 0xff, 0xe9, 0x5a, 0x92, 0xa4, 0x36, 0x20, 0x64, 0x41, 0xb6};

ESP8266WiFiMulti WiFiMulti;
Adafruit_SSD1306 display(128,64,&Wire,-1);

//Imagen de Davinci
// 'davinci', 128x64px
const unsigned char myBitmap [] PROGMEM = {
  0x00, 0x00, 0x00, 0x00, 0x00, 0x00, 0x00, 0x00, 0x00, 0x00, 0x00, 0x00, 0x00, 0x00, 0x00, 0x00, 
  0x00, 0x00, 0x00, 0x00, 0x00, 0x00, 0x00, 0x00, 0x00, 0x00, 0x00, 0x00, 0x00, 0x00, 0x00, 0x00, 
  0x00, 0x00, 0x00, 0x00, 0x00, 0x00, 0x00, 0x00, 0x00, 0x00, 0x00, 0x00, 0x00, 0x00, 0x00, 0x00, 
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  0x00, 0x00, 0x00, 0x00, 0x00, 0x00, 0x00, 0x00, 0x00, 0x00, 0x00, 0x00, 0x00, 0x00, 0x00, 0x00
};

void setup() {

  Serial.begin(115200);
  // Serial.setDebugOutput(true);
  delay(100); // se da una espera de 100ms para que el display inicie correctamente           
  display.begin(SSD1306_SWITCHCAPVCC, 0x3C);
  delay(1000);
  Serial.println();
  Serial.println();
  Serial.println();

  for (uint8_t t = 4; t > 0; t--) {
    Serial.printf("[SETUP] WAIT %d...\n", t);
    Serial.flush();
    delay(1000);
  }

  WiFi.mode(WIFI_STA);
  WiFiMulti.addAP("", ""); //Nombre y Contraseña de Red
    
  // animacion de introduccion
  display.clearDisplay();
  display.setTextColor(WHITE);
  display.setCursor(0,0);
  display.setTextSize(2);
  display.println("ESCUELA");
  display.setCursor(0,32);
  display.println("DAVINCI");
  display.display();
  display.startscrollright(0x00,0x05);
  delay(1500);
  display.invertDisplay(1);
  display.stopscroll();
  delay(1000);
  
   // muestra de imagen davinci
  display.invertDisplay(0);
  display.clearDisplay();
  display.setCursor(0,0);
  display.drawBitmap(0,0,myBitmap,128,64,WHITE);
  display.display();
  delay(3000);
}

void loop() {
  // wait for WiFi connection
  if ((WiFiMulti.run() == WL_CONNECTED)) {

    std::unique_ptr<BearSSL::WiFiClientSecure>client(new BearSSL::WiFiClientSecure);

    client->setFingerprint(fingerprint);

    HTTPClient https;

    Serial.print("[HTTPS] begin...\n");
    if (https.begin(*client, "https://www.dolarsi.com/api/api.php?type=dolar")) {  // HTTPS

      Serial.print("[HTTPS] GET...\n");
      // start connection and send HTTP header
      int httpCode = https.GET();

      // httpCode will be negative on error
      if (httpCode > 0) {
        // HTTP header has been send and Server response header has been handled
        Serial.printf("[HTTPS] GET... code: %d\n", httpCode);

        // file found at server
        if (httpCode == HTTP_CODE_OK || httpCode == HTTP_CODE_MOVED_PERMANENTLY) {
          String payload = https.getString();
          //Serial.println(payload);
          //ArduinoJson deserializador
          const size_t bufferSize = JSON_ARRAY_SIZE(6) + 13*JSON_OBJECT_SIZE(0) + 6*JSON_OBJECT_SIZE(1) + 3*JSON_OBJECT_SIZE(2) + 3*JSON_OBJECT_SIZE(6) + 3*JSON_OBJECT_SIZE(9) + 430;
          DynamicJsonDocument doc(bufferSize);
          deserializeJson(doc,payload);
          //Guarda valores de dolar oficial en variables
          JsonObject oficial = doc[0]["casa"];
          const char* onombre = oficial["nombre"]; 
          const char* ocompra = oficial["compra"]; 
          const char* oventa = oficial["venta"]; 
          //Guarda valores de dolar blue en variables
          JsonObject blue = doc[1]["casa"];
          const char* bnombre = blue["nombre"]; 
          const char* bcompra = blue["compra"]; 
          const char* bventa = blue["venta"]; 
          
          //Muestra datos por Serial
          Serial.print("Dolar: ");
          Serial.println(onombre);
          Serial.print("Compra: ");
          Serial.println(ocompra);
          Serial.print("Venta: ");
          Serial.println(oventa);
          Serial.println("------------");
          Serial.print("Dolar: ");
          Serial.println(bnombre);
          Serial.print("Compra:");
          Serial.println(bcompra);
          Serial.print("Venta:");
          Serial.println(bventa);
          
          //Muestra datos por OLED
          display.clearDisplay(); 
          display.setCursor(0, 0); 
          display.setTextColor(WHITE);
          display.setTextSize(1);
          display.println(onombre);
          display.print("Compra: ");
          display.println(ocompra); 
          display.print("Venta: ");
          display.println(oventa);
          display.println("-----------------");
          display.println(bnombre);
          display.print("Compra: ");
          display.println(bcompra); 
          display.print("Venta: ");
          display.println(bventa);
          display.display(); 
        }
      } else {
        Serial.printf("[HTTPS] GET... failed, error: %s\n", https.errorToString(httpCode).c_str());
      }

      https.end();
    } else {
      Serial.printf("[HTTPS] Unable to connect\n");
    }
  }

  Serial.println("Wait 1 minute before next round...");
  delay(60000);
}
